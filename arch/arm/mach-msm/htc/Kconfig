## arch/arm/mach-msm/htc/Kconfig
```kconfig
config MACH_HTC
	bool

menu "HTC Board Selection"
source "arch/arm/mach-msm/htc/Kconfig.board"
endmenu


menu "HTC Specific Patches"

config MSM8960_ONLY
                depends on MACH_HTC
		default n
		bool "ARCH MSM8960 only"
		help
		 Help to separate MSM8960 code from other ARCH

config HTC_HEADSET
	tristate "HTC 2 Wire detection driver"
	default n
	help
	 Provides support for detecting HTC 2 wire devices, such as wired
	 headset, on the trout platform. Can be used with the msm serial
	 debugger, but not with serial console.

config HTC_HEADSET_MGR
	tristate "HTC headset manager driver"
	default n
	help
	  Provides support of HTC headset manager.

config HTC_HEADSET_GPIO
	tristate "HTC GPIO headset detection driver"
	depends on HTC_HEADSET_MGR
	default n
	help
	  Provides support of HTC GPIO headset detection.

config HTC_HEADSET_PMIC
	tristate "HTC PMIC headset detection driver"
	depends on HTC_HEADSET_MGR
	default n
	help
	  Provides support of HTC PMIC headset detection.

config HTC_PWRSINK
	depends on MSM_SMD
	default n
	bool "HTC Power Sink Driver"

config HTC_BATT_CORE
	depends on POWER_SUPPLY
	default n
	bool "HTC battery core driver"

config HTC_BATT_8960
	depends on HTC_BATT_CORE
	default n
	bool "HTC battery driver for 8960"

endmenu
```

## arch/arm/mach-msm/htc/Kconfig.board
```kconfig
#
# Inlcude the specific Kconfig file for HTC board
#

# VILLE
source "arch/arm/mach-msm/htc/ville/Kconfig"
# ELITE/EVITA
source "arch/arm/mach-msm/htc/elite/Kconfig"
# JET/JEWEL
source "arch/arm/mach-msm/htc/jet/Kconfig"
# M7
source "arch/arm/mach-msm/htc/m7/Kconfig"

config MACH_HTC_DUMMY
	bool "NONE (No device)"
```

## arch/arm/mach-msm/htc/m7/Kconfig
```kconfig
config MACH_M7_UL
	depends on ARCH_MSM8960
	select MACH_HTC
	bool "HTC M7"
	help
	  Support for the HTC M7 device.
```
